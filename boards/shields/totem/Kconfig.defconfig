## boards/shields/totem/Kconfig.defconfig
```kconfig
# Copyright (c) 2020 The ZMK Contributors
# SPDX-License-Identifier: MIT

if SHIELD_TOTEM_DONGLE || SHIELD_TOTEM_LEFT_CENTRAL

config ZMK_KEYBOARD_NAME
	default "Totem"

config ZMK_SPLIT_ROLE_CENTRAL
  default y

config ZMK_USB
	default y

endif

if ZMK_DISPLAY

config I2C
  default y

config SSD1306
  default y



config LV_Z_MEM_POOL_SIZE
  default 8192



choice ZMK_DISPLAY_WORK_QUEUE
    default ZMK_DISPLAY_WORK_QUEUE_DEDICATED
endchoice

endif

if LVGL

config LV_Z_VDB_SIZE
  default 64

config LV_DPI_DEF
  default 148

config LV_Z_BITS_PER_PIXEL
  default 1

choice LV_COLOR_DEPTH
  default LV_COLOR_DEPTH_1
endchoice

endif

if SHIELD_TOTEM_DONGLE || SHIELD_TOTEM_LEFT_CENTRAL || SHIELD_TOTEM_LEFT_PERIPHERAL || SHIELD_TOTEM_RIGHT_PERIPHERAL

config ZMK_SPLIT
  default y

endif
```

## boards/shields/totem/Kconfig.shield
```kconfig
# Copyright (c) 2020 The ZMK Contributors
# SPDX-License-Identifier: MIT

config SHIELD_TOTEM_DONGLE
	def_bool $(shields_list_contains,totem_dongle)

config SHIELD_TOTEM_LEFT_CENTRAL
    def_bool $(shields_list_contains,totem_left_central)

config SHIELD_TOTEM_LEFT_PERIPHERAL
    def_bool $(shields_list_contains,totem_left_peripheral)

config SHIELD_TOTEM_RIGHT_PERIPHERAL
    def_bool $(shields_list_contains,totem_right_peripheral)
```
